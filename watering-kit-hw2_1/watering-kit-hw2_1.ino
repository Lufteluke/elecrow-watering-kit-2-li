#include <Wire.h>
#include <U8g2lib.h>
#include <RTClib.h>
#include <Adafruit_SleepyDog.h>

U8G2_SH1106_128X64_NONAME_2_HW_I2C u8g2(U8G2_R0, /* clock=*/ SCL, /* data=*/ SDA, /* reset=*/ U8X8_PIN_NONE);
RTC_DS1307 RTC;

//SETTINGS
bool use_watchdog = false;
bool capacitive_sensors = true;
int water_pump_trigger = 30;
int water_pump_buffer = 55;

// set all moisture sensors pins
int moisture_sensor[4] = {A0, A1, A2, A3};

// declare moisture values
int moisture_value[4];

// set water relays
int relay[4] = {6, 8, 9, 10};

// set water pump
int pump = 4;

// set side-button
int button = 12;

//pump state 1:open 0:close
int pump_state_flag = 0;

//relay state 1:open 0:closed
int relay_state_flag[4];

char daysOfTheWeek[7][12] = {"Sun", "Mon", "Tue", "Wed", "Thu", "Fri", "Sat",};

// wet sensors
static const unsigned char bitmap_good[] U8X8_PROGMEM = {
  0x00, 0x00, 0x00, 0x00, 0x00, 0x00, 0x00, 0x00, 0x00, 0x00, 0x00, 0x00,
  0x00, 0x00, 0x00, 0x00, 0x00, 0x00, 0x00, 0x00, 0x00, 0x00, 0x00, 0x00,
  0x00, 0x00, 0x00, 0x00, 0x00, 0x30, 0x38, 0x00, 0x00, 0x78, 0x7c, 0x00,
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  0x00, 0x00, 0x00, 0x00, 0x00, 0x00, 0x00, 0x00, 0x00, 0x00, 0x00, 0x00
};

// dry sensors
static const unsigned char bitmap_bad[] U8X8_PROGMEM = {
  0x00, 0x00, 0x00, 0x00, 0x00, 0x00, 0x00, 0x00, 0x00, 0x00, 0x00, 0x00,
  0x00, 0x00, 0x00, 0x00, 0x00, 0x00, 0x00, 0x00, 0x00, 0x70, 0xc0, 0x00,
  0x00, 0xf8, 0xe0, 0x01, 0x00, 0x7c, 0xf0, 0x01, 0x00, 0x38, 0xe0, 0x00,
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  0x00, 0x00, 0x00, 0x00, 0x00, 0x00, 0x00, 0x00, 0x00, 0x00, 0x00, 0x00
};

//  Logo
static const unsigned char bitmap_logo[] U8X8_PROGMEM = {
  0x00, 0x00, 0x00, 0x00, 0x00, 0x00, 0x00, 0x00, 0x00, 0x00, 0x00, 0x00,
  0x00, 0x00, 0x00, 0x00, 0x00, 0x00, 0x00, 0x00, 0x00, 0x00, 0x00, 0x00,
  0x00, 0x00, 0x00, 0x00, 0x00, 0x00, 0x00, 0x00, 0x00, 0x00, 0x00, 0x00,
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  0x00, 0x00, 0x00, 0x00
};


void setup()
{
  Wire.begin();
  RTC.begin();
  Serial.begin(9600);
  u8g2.begin();

  // declare pump as output
  pinMode(pump, OUTPUT);
  // declare relay as output
  for (int i = 0; i < 4; i++) {
    pinMode(relay[i], OUTPUT);
  }

  // declare switch as input
  pinMode(button, INPUT);

  drawSplashScreen();
  delay(5000);
}

void loop()
{
  // read the value from the moisture sensors:
  read_value();
  waterPlants();
  
  int button_state = digitalRead(button);
  if (button_state == 1)
  {
    drawMainScreen();
  }
  else
  {
    //drawTimeScreen();
    drawSplashScreen();
  }

  if (use_watchdog) Watchdog.sleep(1000);
  else delay(1000);
}


//Set moisture value
void read_value()
{
  for (int i = 0; i < 4; i++) {
    float raw = analogRead(moisture_sensor[i]);

    if (capacitive_sensors) {
      moisture_value[i] = map(raw, 590, 360, 0, 100); delay(20);
    }
    else {
      moisture_value[i] = (raw * 120) / 1023; delay(20);
    }
    moisture_value[i] = max(0, moisture_value[i]);
  }
}

void waterPlants()
{
  for (int i = 0; i < 4; i++) {
    {
      if (moisture_value[i] < water_pump_trigger)
      {
        digitalWrite(relay[i], HIGH);
        relay_state_flag[i] = 1;
        delay(50);
        if (pump_state_flag == 0)
        {
          digitalWrite(pump, HIGH);
          pump_state_flag = 1;
          delay(50);
        }
      }
      else if (moisture_value[i] > water_pump_buffer && relay_state_flag[i] == 1)
      {
        digitalWrite(relay[i], LOW);
        relay_state_flag[i] = 0;
        delay(50);
        if ((relay_state_flag[0] + relay_state_flag[1] + relay_state_flag[2] + relay_state_flag[3]) == 0)
        {
          digitalWrite(pump, LOW);
          pump_state_flag = 0;
          delay(50);
        }
      }
    }
  }
}

void drawSplashScreen(void)
{
  u8g2.firstPage();
  do
  {
    u8g2.drawXBMP(0, 0, 128, 64, bitmap_logo);
  } while ( u8g2.nextPage() );
}

void drawMainScreen(void)
{
  u8g2.firstPage();
  do
  {
    drawPercent();
    drawIcons();
  } while ( u8g2.nextPage() );
}

void drawTimeScreen(void)
{
  DateTime now = RTC.now();
  //Serial.print(now.year(), DEC);


  u8g2.firstPage();
  do
  {
    if (! RTC.isrunning())
    {
      u8g2.setFont(u8g2_font_6x10_tr);
      u8g2.setCursor(5, 20);
      u8g2.print("RTC is NOT running!");
      RTC.adjust(DateTime(__DATE__, __TIME__));
    }
    else
    {
      u8g2.setFont(u8g2_font_7x13_tr);
      char datestr[32]; //make this big enough to hold the resulting string
      snprintf(datestr, sizeof(datestr), "%4d-%02d-%02d  [%s]", now.year(), now.month(), now.day(), daysOfTheWeek[now.dayOfTheWeek()]);
      u8g2.setCursor(5, 11);
      u8g2.print (datestr);

      char timestr[9];
      snprintf(timestr, sizeof(timestr), "%02d:%02d:%02d", now.hour(), now.minute(), now.second());
      u8g2.setCursor(35, 33);
      u8g2.print(timestr);
    }
  } while (u8g2.nextPage());
}



//Style the flowers     bitmap_bad: bad flowers     bitmap_good:good  flowers
void drawIcons(void)
{
  for (int i = 0; i < 4; i++) {
    {
      if (moisture_value[i] < 30)
      {
        u8g2.drawXBMP(32 * i, 0, 32, 30, bitmap_bad);
      }
      else
      {
        u8g2.drawXBMP(32 * i, 0, 32, 30, bitmap_good);
      }
      //needs to finish drawing, i guess
      delay(30);
    }
  }
}

void drawPercent(void)
{
  char moisture_value_str[4][5];
  read_value();

  for (int i = 0; i < 4; i++) {
    {
      itoa(moisture_value[i], moisture_value_str[i], 10);
    }

    u8g2.setFont(u8g2_font_8x13_tr);
    u8g2.setCursor(9, 60);
    u8g2.print("A0  A1  A2  A3");

    for (int i = 0; i < 4; i++) {
      {
        int offset = 32 * i;
        if (moisture_value[i] < 10) offset += 12;
        else if (moisture_value[i] <= 100) offset += 6;

        u8g2.drawStr(offset, 45, moisture_value_str[i]);
        u8g2.setCursor(32 * i + 23, 45 );
        u8g2.print("%");
      }
    }
  }
}
